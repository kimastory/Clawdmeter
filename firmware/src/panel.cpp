#include "panel.h"
#include "pets.h"
#include "theme.h"
#include "display_cfg.h"
#include <Arduino.h>
#include <lvgl.h>

// Korean (Pretendard) subset fonts — generated by tools/gen_kr_fonts.sh.
// These also carry ASCII + the degree sign, so temperatures show "25°".
LV_FONT_DECLARE(font_kr_60);
LV_FONT_DECLARE(font_kr_40);
LV_FONT_DECLARE(font_kr_26);
LV_FONT_DECLARE(font_kr_18);
LV_FONT_DECLARE(font_kr_14);

#define SCR_W  LCD_WIDTH
#define SCR_H  LCD_HEIGHT

// The dog+cat companions live in the top-left corner on every screen (drawn by
// pets.cpp as the topmost siblings). Keep that corner clear of content.
#define PET_RESERVE 92

typedef enum { PANEL_CLOCK = 0, PANEL_INFO, PANEL_STOCK, PANEL_COUNT } panel_screen_t;

static panel_screen_t current = PANEL_CLOCK;
static uint32_t auto_last_ms = 0;
#define AUTO_CYCLE_MS 15000UL

// ---- Clock screen ----
static lv_obj_t* clock_scr = nullptr;
static lv_obj_t* clock_lbl = nullptr;
static lv_obj_t* date_lbl = nullptr;
#define CAL_COLS 7
#define CAL_ROWS 6
static lv_obj_t* cal_cells[CAL_ROWS * CAL_COLS] = {nullptr};
static lv_obj_t* cal_labels[CAL_ROWS * CAL_COLS] = {nullptr};

// ---- Combined weather + air-quality screen ----
static lv_obj_t* info_scr = nullptr;
static lv_obj_t* w_temp = nullptr;   // big temperature
static lv_obj_t* w_cond = nullptr;   // condition text
static lv_obj_t* w_feels = nullptr;
static lv_obj_t* w_hum = nullptr;
static lv_obj_t* w_rain = nullptr;
static lv_obj_t* a_value = nullptr;  // big AQI number
static lv_obj_t* a_cat = nullptr;    // AQI category
static lv_obj_t* a_pm25 = nullptr;
static lv_obj_t* a_pm10 = nullptr;

// ---- Stock screen ----
static lv_obj_t* stock_scr = nullptr;
static lv_obj_t* stock_name_lbl = nullptr;
static lv_obj_t* stock_price_lbl = nullptr;
static lv_obj_t* stock_diff_lbl = nullptr;
static lv_obj_t* stock_chart = nullptr;
static lv_chart_series_t* stock_series = nullptr;
static lv_obj_t* stock_y_hi = nullptr;    // price-axis ticks
static lv_obj_t* stock_y_mid = nullptr;
static lv_obj_t* stock_y_lo = nullptr;
static lv_obj_t* stock_month_lbls[STOCK_MONTH_MARKS_MAX] = {nullptr};  // month-axis ticks

// ---- Clock interpolation (ticks even if NTP never syncs) ----
static bool     clk_valid = false;
static uint32_t clk_base_ms = 0;
static int clk_h = 0, clk_m = 0, clk_s = 0;
static int shown_y = 0, shown_mo = 0, shown_d = 0, shown_min = -1;

static int last_mood = -1;

static const char* const DOW[7] = {"일", "월", "화", "수", "목", "금", "토"};

static bool is_leap(int y) { return (y % 4 == 0 && y % 100 != 0) || (y % 400 == 0); }
static int days_in_month(int y, int m) {
    static const int d[] = {31,28,31,30,31,30,31,31,30,31,30,31};
    if (m == 2 && is_leap(y)) return 29;
    if (m < 1 || m > 12) return 0;
    return d[m - 1];
}
static int weekday(int y, int m, int d) {   // Sakamoto, 0=Sunday
    static const int t[] = {0,3,2,5,0,3,5,1,4,6,2,4};
    if (m < 3) y--;
    return (y + y/4 - y/100 + y/400 + t[m-1] + d) % 7;
}

static const char* wmo_text(int code) {
    switch (code) {
    case 0:  return "맑음";
    case 1:  return "대체로 맑음";
    case 2:  return "부분 흐림";
    case 3:  return "흐림";
    case 45: case 48: return "안개";
    case 51: case 53: case 55: return "이슬비";
    case 56: case 57: return "어는 이슬비";
    case 61: case 63: case 65: return "비";
    case 66: case 67: return "어는 비";
    case 71: case 73: case 75: return "눈";
    case 77: return "진눈깨비";
    case 80: case 81: case 82: return "소나기";
    case 85: case 86: return "눈 소나기";
    case 95: return "뇌우";
    case 96: case 99: return "뇌우 우박";
    default: return "알 수 없음";
    }
}

static const char* aqi_category(int aqi, lv_color_t* col) {
    if (aqi < 0)    { *col = THEME_DIM;              return "—"; }
    if (aqi <= 50)  { *col = lv_color_hex(0x54a352); return "좋음"; }
    if (aqi <= 100) { *col = lv_color_hex(0xd6c23e); return "보통"; }
    if (aqi <= 150) { *col = lv_color_hex(0xdb8f34); return "나쁨"; }
    if (aqi <= 300) { *col = lv_color_hex(0xc0392b); return "매우 나쁨"; }
    *col = lv_color_hex(0x8e44ad); return "위험";
}

static int mood_group(const InfoData* d) {
    int g = 2;
    if (d->aqi_valid) {
        if (d->us_aqi <= 50)       g = 3;
        else if (d->us_aqi <= 100) g = 2;
        else if (d->us_aqi <= 150) g = 1;
        else                       g = 0;
    }
    if (d->weather_valid) {
        int c = d->weather_code;
        bool stormy = (c >= 61 && c <= 99);
        bool clear  = (c <= 1);
        if (stormy && g > 0) g--;
        else if (clear && g < 3 && (!d->aqi_valid || d->us_aqi <= 100)) g++;
    }
    if (g < 0) g = 0;
    if (g > 3) g = 3;
    return g;
}

static lv_obj_t* make_screen(void) {
    lv_obj_t* c = lv_obj_create(lv_screen_active());
    lv_obj_set_size(c, SCR_W, SCR_H);
    lv_obj_set_pos(c, 0, 0);
    lv_obj_set_style_bg_color(c, THEME_BG, 0);
    lv_obj_set_style_bg_opa(c, LV_OPA_COVER, 0);
    lv_obj_set_style_border_width(c, 0, 0);
    lv_obj_set_style_pad_all(c, 0, 0);
    lv_obj_clear_flag(c, LV_OBJ_FLAG_SCROLLABLE);
    lv_obj_add_flag(c, LV_OBJ_FLAG_HIDDEN);
    return c;
}

static lv_obj_t* mklabel(lv_obj_t* parent, const lv_font_t* font, lv_color_t color,
                         const char* text) {
    lv_obj_t* l = lv_label_create(parent);
    lv_label_set_text(l, text);
    lv_obj_set_style_text_font(l, font, 0);
    lv_obj_set_style_text_color(l, color, 0);
    return l;
}

static lv_obj_t* mkcentered(lv_obj_t* parent, const lv_font_t* font, lv_color_t color,
                            const char* text, int x, int y, int w) {
    lv_obj_t* l = mklabel(parent, font, color, text);
    lv_obj_set_width(l, w);
    lv_obj_set_style_text_align(l, LV_TEXT_ALIGN_CENTER, 0);
    lv_obj_set_pos(l, x, y);
    return l;
}

// A big centered "value / LABEL" stat cell (value font enlarged for legibility).
static void make_stat(lv_obj_t* parent, int x, int y, int w,
                      const char* label_text, lv_obj_t** out_value) {
    *out_value = mkcentered(parent, &font_kr_26, THEME_TEXT, "--", x, y, w);
    mkcentered(parent, &font_kr_14, THEME_DIM, label_text, x, y + 30, w);
}

// ---- Clock screen ----
static void init_clock_screen(void) {
    clock_scr = make_screen();

    clock_lbl = mklabel(clock_scr, &font_kr_60, THEME_TEXT, "--:--");
    lv_obj_set_pos(clock_lbl, PET_RESERVE + 10, 6);

    date_lbl = mkcentered(clock_scr, &font_kr_26, THEME_DIM, "----년 --월 --일", 0, 74, SCR_W);

    const int cal_x = 8, cal_y = 110;
    const int cw = (SCR_W - 16) / CAL_COLS;
    const int dow_h = 18, row_h = 19;

    for (int c = 0; c < CAL_COLS; c++) {
        mkcentered(clock_scr, &font_kr_14,
                   (c == 0) ? lv_color_hex(0xc0705f) : THEME_DIM, DOW[c],
                   cal_x + c * cw, cal_y, cw);
    }
    for (int r = 0; r < CAL_ROWS; r++) {
        for (int c = 0; c < CAL_COLS; c++) {
            int idx = r * CAL_COLS + c;
            lv_obj_t* cell = lv_obj_create(clock_scr);
            lv_obj_set_pos(cell, cal_x + c * cw, cal_y + dow_h + r * row_h);
            lv_obj_set_size(cell, cw - 2, row_h - 2);
            lv_obj_set_style_bg_opa(cell, LV_OPA_TRANSP, 0);
            lv_obj_set_style_border_width(cell, 0, 0);
            lv_obj_set_style_pad_all(cell, 0, 0);
            lv_obj_set_style_radius(cell, 6, 0);
            lv_obj_clear_flag(cell, LV_OBJ_FLAG_SCROLLABLE);
            cal_cells[idx] = cell;
            lv_obj_t* l = mklabel(cell, &font_kr_14, THEME_TEXT, "");
            lv_obj_center(l);
            cal_labels[idx] = l;
        }
    }
}

static void render_calendar(int y, int mo, int d) {
    for (int i = 0; i < CAL_ROWS * CAL_COLS; i++) {
        lv_label_set_text(cal_labels[i], "");
        lv_obj_set_style_bg_opa(cal_cells[i], LV_OPA_TRANSP, 0);
    }
    int first = weekday(y, mo, 1);
    int n = days_in_month(y, mo);
    for (int day = 1; day <= n; day++) {
        int idx = first + day - 1;
        if (idx < 0 || idx >= CAL_ROWS * CAL_COLS) continue;
        bool today = (day == d);
        lv_label_set_text_fmt(cal_labels[idx], "%d", day);
        lv_obj_set_style_text_color(cal_labels[idx], today ? THEME_BG : THEME_TEXT, 0);
        lv_obj_set_style_bg_color(cal_cells[idx], THEME_ACCENT, 0);
        lv_obj_set_style_bg_opa(cal_cells[idx], today ? LV_OPA_COVER : LV_OPA_TRANSP, 0);
    }
}

// ---- Combined weather + air quality screen ----
static void init_info_screen(void) {
    info_scr = make_screen();
    int half = SCR_W / 2;
    int third = SCR_W / 3;

    // Weather headline: "기온  25°  이슬비" on one row. Shifted right so it
    // clears the dog+cat companions in the top-left corner.
    lv_obj_t* w_row = lv_obj_create(info_scr);
    lv_obj_set_size(w_row, SCR_W - PET_RESERVE - 4 - 6, 48);
    lv_obj_set_pos(w_row, PET_RESERVE + 4, 6);
    lv_obj_set_style_bg_opa(w_row, LV_OPA_TRANSP, 0);
    lv_obj_set_style_border_width(w_row, 0, 0);
    lv_obj_set_style_pad_all(w_row, 0, 0);
    lv_obj_set_style_pad_column(w_row, 8, 0);
    lv_obj_clear_flag(w_row, LV_OBJ_FLAG_SCROLLABLE);
    lv_obj_set_flex_flow(w_row, LV_FLEX_FLOW_ROW);
    lv_obj_set_flex_align(w_row, LV_FLEX_ALIGN_CENTER, LV_FLEX_ALIGN_CENTER, LV_FLEX_ALIGN_CENTER);

    mklabel(w_row, &font_kr_18, THEME_DIM, "기온");
    w_temp = mklabel(w_row, &font_kr_40, THEME_TEXT, "--°");
    w_cond = mklabel(w_row, &font_kr_18, THEME_ACCENT, "--");

    // Weather stats row (enlarged values).
    make_stat(info_scr, 0,           80, third, "체감", &w_feels);
    make_stat(info_scr, third,       80, third, "습도", &w_hum);
    make_stat(info_scr, third * 2,   80, third, "강수", &w_rain);

    // Divider.
    lv_obj_t* line = lv_obj_create(info_scr);
    lv_obj_set_size(line, SCR_W - 40, 2);
    lv_obj_set_pos(line, 20, 132);
    lv_obj_set_style_bg_color(line, THEME_BAR_BG, 0);
    lv_obj_set_style_bg_opa(line, LV_OPA_COVER, 0);
    lv_obj_set_style_border_width(line, 0, 0);
    lv_obj_set_style_radius(line, 0, 0);

    // Air quality header: "대기질  50  좋음" on one centered line, so it is
    // clear that the number is the air-quality index.
    lv_obj_t* aqi_row = lv_obj_create(info_scr);
    lv_obj_set_size(aqi_row, SCR_W, 46);
    lv_obj_set_pos(aqi_row, 0, 138);
    lv_obj_set_style_bg_opa(aqi_row, LV_OPA_TRANSP, 0);
    lv_obj_set_style_border_width(aqi_row, 0, 0);
    lv_obj_set_style_pad_all(aqi_row, 0, 0);
    lv_obj_set_style_pad_column(aqi_row, 8, 0);
    lv_obj_clear_flag(aqi_row, LV_OBJ_FLAG_SCROLLABLE);
    lv_obj_set_flex_flow(aqi_row, LV_FLEX_FLOW_ROW);
    lv_obj_set_flex_align(aqi_row, LV_FLEX_ALIGN_CENTER, LV_FLEX_ALIGN_CENTER, LV_FLEX_ALIGN_CENTER);

    mklabel(aqi_row, &font_kr_18, THEME_DIM, "대기질");
    a_value = mklabel(aqi_row, &font_kr_40, THEME_DIM, "--");
    a_cat   = mklabel(aqi_row, &font_kr_26, THEME_DIM, "--");

    // Air quality stats (enlarged values).
    make_stat(info_scr, 0,    186, half, "초미세먼지", &a_pm25);
    make_stat(info_scr, half, 186, half, "미세먼지",   &a_pm10);
}

// Format an integer with thousand-separator commas, e.g. -46125 -> "-46,125".
static void format_commas(long value, char* buf, size_t buf_size) {
    unsigned long v = (value < 0) ? (unsigned long)(-value) : (unsigned long)value;
    char digits[24];
    int nd = 0;
    do { digits[nd++] = '0' + (v % 10); v /= 10; } while (v > 0);

    char out[24];
    int oi = 0;
    for (int i = nd - 1; i >= 0; i--) {
        out[oi++] = digits[i];
        if (i > 0 && i % 3 == 0) out[oi++] = ',';
    }
    out[oi] = '\0';
    snprintf(buf, buf_size, "%s%s", (value < 0) ? "-" : "", out);
}

// Chart geometry, shared between init (layout) and update (label refresh).
#define CHART_X      64   // leaves a price-label gutter on the left
#define CHART_Y      128
#define CHART_W      (SCR_W - CHART_X - 8)
#define CHART_H      78
#define DATE_ROW_Y   (CHART_Y + CHART_H + 4)

// A small right-aligned, single-line label — used for the chart's axis ticks
// so the digits line up against the chart's edges like a real stock chart.
// CLIP (not the lv_label default WRAP) keeps a 6-digit price on one line.
static lv_obj_t* mkright(lv_obj_t* parent, const lv_font_t* font, lv_color_t color,
                         const char* text, int right_x, int y, int w) {
    lv_obj_t* l = mklabel(parent, font, color, text);
    lv_obj_set_width(l, w);
    lv_obj_set_style_text_align(l, LV_TEXT_ALIGN_RIGHT, 0);
    lv_label_set_long_mode(l, LV_LABEL_LONG_MODE_CLIP);
    lv_obj_set_pos(l, right_x - w, y);
    return l;
}

// ---- Stock screen (name, live price, gain/loss vs avg-buy, trend chart) ----
static void init_stock_screen(void) {
    stock_scr = make_screen();

    // Name: short, so it fits to the right of the pets at their own row.
    stock_name_lbl = mklabel(stock_scr, &font_kr_18, THEME_DIM, "--");
    lv_obj_set_pos(stock_name_lbl, PET_RESERVE + 4, 16);

    // Price: can be wide (large font + thousands separators), so it gets its
    // own row below the pets' vertical extent and uses the full width.
    stock_price_lbl = mklabel(stock_scr, &font_kr_40, THEME_TEXT, "--원");
    lv_obj_set_pos(stock_price_lbl, 8, 48);

    // Gain/loss vs. average buy price, centered, colour-coded.
    stock_diff_lbl = mkcentered(stock_scr, &font_kr_18, THEME_DIM,
                                "평단대비 --", 0, 98, SCR_W);

    // Price trend chart (5 trading days, hourly closes).
    stock_chart = lv_chart_create(stock_scr);
    lv_obj_set_size(stock_chart, CHART_W, CHART_H);
    lv_obj_set_pos(stock_chart, CHART_X, CHART_Y);
    lv_obj_clear_flag(stock_chart, LV_OBJ_FLAG_SCROLLABLE);
    lv_obj_set_style_bg_color(stock_chart, THEME_PANEL, 0);
    lv_obj_set_style_bg_opa(stock_chart, LV_OPA_COVER, 0);
    lv_obj_set_style_border_width(stock_chart, 0, 0);
    lv_obj_set_style_radius(stock_chart, 6, 0);
    lv_obj_set_style_line_color(stock_chart, THEME_BAR_BG, LV_PART_MAIN);
    lv_obj_set_style_size(stock_chart, 0, 0, LV_PART_INDICATOR);  // hide point dots
    lv_chart_set_type(stock_chart, LV_CHART_TYPE_LINE);
    lv_chart_set_div_line_count(stock_chart, 3, 4);   // grid: 3 horizontal, 4 vertical
    lv_chart_set_point_count(stock_chart, STOCK_HISTORY_MAX);
    stock_series = lv_chart_add_series(stock_chart, THEME_ACCENT, LV_CHART_AXIS_PRIMARY_Y);

    // Price-axis ticks (high / mid / low), right-aligned against the chart.
    stock_y_hi  = mkright(stock_scr, &font_kr_14, THEME_DIM, "--", CHART_X - 4, CHART_Y - 6, 58);
    stock_y_mid = mkright(stock_scr, &font_kr_14, THEME_DIM, "--", CHART_X - 4, CHART_Y + CHART_H / 2 - 7, 58);
    stock_y_lo  = mkright(stock_scr, &font_kr_14, THEME_DIM, "--", CHART_X - 4, CHART_Y + CHART_H - 8, 58);

    // Month-axis ticks — a pool sized for the worst case; panel_update_stock
    // positions and shows only as many as the current data actually spans.
    for (int i = 0; i < STOCK_MONTH_MARKS_MAX; i++) {
        stock_month_lbls[i] = mklabel(stock_scr, &font_kr_14, THEME_DIM, "");
        lv_obj_set_pos(stock_month_lbls[i], CHART_X, DATE_ROW_Y);
        lv_obj_add_flag(stock_month_lbls[i], LV_OBJ_FLAG_HIDDEN);
    }
}

void panel_init(void) {
    lv_obj_t* scr = lv_screen_active();
    lv_obj_set_style_bg_color(scr, THEME_BG, 0);
    lv_obj_set_style_bg_opa(scr, LV_OPA_COVER, 0);

    init_clock_screen();
    init_info_screen();
    init_stock_screen();
    pets_init(scr);   // dog + cat companions, top-left, on top of every screen

    current = PANEL_CLOCK;
    lv_obj_clear_flag(clock_scr, LV_OBJ_FLAG_HIDDEN);
    auto_last_ms = millis();
}

static void show_screen(panel_screen_t s) {
    lv_obj_add_flag(clock_scr, LV_OBJ_FLAG_HIDDEN);
    lv_obj_add_flag(info_scr, LV_OBJ_FLAG_HIDDEN);
    lv_obj_add_flag(stock_scr, LV_OBJ_FLAG_HIDDEN);
    switch (s) {
    case PANEL_CLOCK: lv_obj_clear_flag(clock_scr, LV_OBJ_FLAG_HIDDEN); break;
    case PANEL_INFO:  lv_obj_clear_flag(info_scr, LV_OBJ_FLAG_HIDDEN); break;
    case PANEL_STOCK: lv_obj_clear_flag(stock_scr, LV_OBJ_FLAG_HIDDEN); break;
    default: break;
    }
    current = s;
    auto_last_ms = millis();
}

void panel_next_screen(void) {
    show_screen((panel_screen_t)((current + 1) % PANEL_COUNT));
}

void panel_show_index(int i) {
    if (i < 0 || i >= PANEL_COUNT) return;
    show_screen((panel_screen_t)i);
}

void panel_pet_next(void) {
    pets_poke();   // jump the dog+cat to a fresh scene
}

void panel_tick(void) {
    if (clk_valid) {
        uint32_t elapsed = (millis() - clk_base_ms) / 1000;
        int tod = (clk_h * 3600 + clk_m * 60 + clk_s + (int)elapsed) % 86400;
        int m = (tod / 60) % 60;
        if (m != shown_min) {
            shown_min = m;
            lv_label_set_text_fmt(clock_lbl, "%d:%02d", tod / 3600, m);
        }
    }
    if (millis() - auto_last_ms >= AUTO_CYCLE_MS) panel_next_screen();
}

void panel_update(const InfoData* d) {
    if (!d) return;

    if (d->time_valid) {
        clk_h = d->hour; clk_m = d->minute; clk_s = d->second;
        clk_base_ms = millis();
        clk_valid = true;
        shown_min = -1;
        if (d->year != shown_y || d->month != shown_mo || d->day != shown_d) {
            shown_y = d->year; shown_mo = d->month; shown_d = d->day;
            lv_label_set_text_fmt(date_lbl, "%d년 %d월 %d일 (%s)",
                                  d->year, d->month, d->day,
                                  DOW[weekday(d->year, d->month, d->day)]);
            render_calendar(d->year, d->month, d->day);
        }
    }

    if (d->weather_valid) {
        lv_label_set_text_fmt(w_temp, "%d°", (int)lroundf(d->temp_c));
        lv_label_set_text(w_cond, wmo_text(d->weather_code));
        lv_label_set_text_fmt(w_feels, "%d°", (int)lroundf(d->feels_c));
        lv_label_set_text_fmt(w_hum, "%d%%", d->humidity);
        lv_label_set_text_fmt(w_rain, "%d%%", d->precip_prob);
    }

    if (d->aqi_valid) {
        lv_color_t col;
        const char* cat = aqi_category(d->us_aqi, &col);
        lv_label_set_text_fmt(a_value, "%d", d->us_aqi);
        lv_obj_set_style_text_color(a_value, col, 0);
        lv_label_set_text(a_cat, cat);
        lv_obj_set_style_text_color(a_cat, col, 0);
        lv_label_set_text_fmt(a_pm25, "%d", (int)lroundf(d->pm2_5));
        lv_label_set_text_fmt(a_pm10, "%d", (int)lroundf(d->pm10));
    }

    if (d->weather_valid || d->aqi_valid) {
        int g = mood_group(d);
        if (g != last_mood) {
            last_mood = g;
            pets_set_mood(g);
        }
    }
}

void panel_update_stock(const StockData* d) {
    if (!d || !d->valid) return;

    lv_label_set_text(stock_name_lbl, d->name);

    char price_buf[24];
    format_commas(d->price, price_buf, sizeof(price_buf));
    lv_label_set_text_fmt(stock_price_lbl, "%s원", price_buf);

    // LVGL's builtin lv_snprintf (LV_USE_STDLIB_SPRINTF) doesn't support %f,
    // so the percentage is computed as whole/fractional ints (one decimal),
    // matching this file's existing float-avoidance convention (see w_temp,
    // a_pm25, etc. above, which all pre-round via lroundf + %d).
    long diff = d->price - d->avg_buy_price;
    int pct_x10 = (d->avg_buy_price > 0)
        ? (int)lroundf(100.0f * diff / (float)d->avg_buy_price * 10.0f)
        : 0;
    int pct_whole = abs(pct_x10) / 10;
    int pct_frac  = abs(pct_x10) % 10;

    char diff_buf[24];
    format_commas(diff, diff_buf, sizeof(diff_buf));   // "-" already baked in if negative
    const char* sign     = (diff > 0) ? "+" : "";
    const char* pct_sign = (diff > 0) ? "+" : (diff < 0) ? "-" : "";
    lv_color_t diff_col = (diff > 0) ? THEME_RED : (diff < 0) ? THEME_BLUE : THEME_DIM;
    lv_label_set_text_fmt(stock_diff_lbl, "평단대비 %s%s원 (%s%d.%d%%)",
                          sign, diff_buf, pct_sign, pct_whole, pct_frac);
    lv_obj_set_style_text_color(stock_diff_lbl, diff_col, 0);

    if (d->history_count > 0) {
        int32_t lo = d->history[0], hi = d->history[0];
        for (int i = 1; i < d->history_count; i++) {
            if (d->history[i] < lo) lo = d->history[i];
            if (d->history[i] > hi) hi = d->history[i];
        }
        int32_t pad = (hi - lo) / 10 + 1;
        int32_t range_lo = lo - pad, range_hi = hi + pad;
        lv_chart_set_axis_range(stock_chart, LV_CHART_AXIS_PRIMARY_Y, range_lo, range_hi);
        lv_chart_set_point_count(stock_chart, d->history_count);
        lv_chart_set_series_values(stock_chart, stock_series, d->history, d->history_count);

        // Price-axis ticks, matching the range/grid just set above.
        char buf[24];
        format_commas(range_hi, buf, sizeof(buf));
        lv_label_set_text(stock_y_hi, buf);
        format_commas((range_lo + range_hi) / 2, buf, sizeof(buf));
        lv_label_set_text(stock_y_mid, buf);
        format_commas(range_lo, buf, sizeof(buf));
        lv_label_set_text(stock_y_lo, buf);

        // Month-axis ticks — one per calendar month the visible history
        // spans, positioned proportionally along the chart's point range.
        int span = d->history_count - 1;
        for (int i = 0; i < STOCK_MONTH_MARKS_MAX; i++) {
            if (i >= d->month_mark_count || span <= 0) {
                lv_obj_add_flag(stock_month_lbls[i], LV_OBJ_FLAG_HIDDEN);
                continue;
            }
            int x = CHART_X + (d->month_mark_idx[i] * CHART_W) / span;
            if (x > CHART_X + CHART_W - 26) x = CHART_X + CHART_W - 26;  // keep "12월" on-screen
            lv_label_set_text_fmt(stock_month_lbls[i], "%d월", d->month_mark_val[i]);
            lv_obj_set_pos(stock_month_lbls[i], x, DATE_ROW_Y);
            lv_obj_clear_flag(stock_month_lbls[i], LV_OBJ_FLAG_HIDDEN);
        }
    }
}
